## conf/layer.conf
```bitbake
# We have a conf and classes directory, add to BBPATH
BBPATH .= ":${LAYERDIR}"

# We have recipes-* directories, add to BBFILES
BBFILES += "${LAYERDIR}/recipes-*/*/*.bb \
            ${LAYERDIR}/recipes-*/*/*.bbappend"

BBFILE_COLLECTIONS += "s5pv210"
BBFILE_PATTERN_s5pv210 = "^${LAYERDIR}/"
BBFILE_PRIORITY_s5pv210 = "5"
LAYERVERSION_s5pv210 = "1"
LAYERSERIES_COMPAT_s5pv210 = "zeus"
```

## conf/machine/s5pv210.conf
```bitbake
require conf/machine/include/tune-cortexa8.inc

KERNEL_IMAGETYPE ?= "zImage"
KERNEL_DEVICETREE ?= "s5pv210-galaxys.dtb"
# append device tree to zImage (see kernel-devicetree.bbclass)
KERNEL_DEVICETREE_BUNDLE ?= "1"

PREFERRED_PROVIDER_virtual/kernel ?= "linux-yocto"
PREFERRED_PROVIDER_virtual/bootloader ?= "u-boot"

UBOOT_EXTLINUX = "1"
UBOOT_EXTLINUX_ROOT = "/dev/mmcblk2p2"
# UBOOT_LOADADDRESS = "0x32000000"

PREFERRED_VERSION_linux-yocto ??= "5.%"

SERIAL_CONSOLE = "115200 ttySAC2"

IMAGE_BOOT_FILES ?= "zImage-s5pv210-galaxys*.dtb.bin s5pv210-galaxys.dtb"
IMAGE_FSTYPES ?= "ext4 ext3 ext2 wic"

WKS_FILE ?= "galaxy-s.wks"

MACHINE_FEATURES += "apm usbhost keyboard vfat ext2 screen touchscreen alsa bluetooth wifi"
```

## wic/galaxy-s.wks
```
part /boot --source bootimg-partition --sourceparams loader=u-boot --ondisk mmcblk2 --fstype vfat --label boot --active --align 4096 --size 8M --extra-space 0
part / --source rootfs --fstype=ext2 --ondisk mmcblk2 --label system

bootloader --timeout 100 --append 'rootwait console=ttySAC2 console=tty earlyprintk'
```
